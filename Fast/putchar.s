plotptr=$80
col=$A0
row=$A1
chr=$A2
chrptr=$A3

putchar:
	sta chr
; Carrage return
	cmp #10
	beq row_down

; row, column to starting address
	lda row
	asl
	clc
	adc #$83
	sta plotptr+1
	lda col
	clc
	adc #$0D
	sta plotptr

	ldy #$08
; get char address
	stz chrptr+1
	lda chr
	sta chrptr
	asl chrptr
	rol chrptr+1
	asl chrptr
	rol chrptr+1
	asl chrptr
	rol chrptr+1
	lda chrptr+1
	clc
	adc #>font
	sta chrptr+1
loop:
	lda (chrptr)
	sta (plotptr)
; next line down
	lda plotptr
	clc
	adc #$40
	sta plotptr
	bcc nocarry
	inc plotptr+1
nocarry:
	inc chrptr
	dey
	bne loop
; MOVE CURSOR FORWARD
	lda col
	inc
	cmp #50
	bcs row_down
	sta col
	rts
row_down:
    stz col
	lda row
	inc
	cmp #30
	sta row
	bne finish
	stz row
finish:
	rts

font=$3000
	.org $3100

	db $00, $00, $00, $00, $00, $00, $00, $00
	db $00, $10, $10, $10, $10, $00, $10, $00
	db $00, $24, $24, $00, $00, $00, $00, $00
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	db $3C, $42, $99, $A1, $A1, $99, $42, $3C
